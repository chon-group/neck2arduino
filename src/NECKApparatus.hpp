/*
 * ============================================================================
 * NECKApparatus.hpp
 * ============================================================================
 *
 * Runtime implementation of a NECK Apparatus.
 *
 * In the NECK body model, an Apparatus represents a physical subsystem that
 * constitutes part of an embodied agent's physical body. An Apparatus is
 * composed of Elements and provides the runtime mechanisms through which
 * these Elements participate in the embodied interaction between mind, body
 * and the physical world.
 *
 * Conceptually:
 *
 *                  ┌────── Embodied Agent ──────┐
 *                  │                            │
 *                  │           Mind             │
 *                  │          (BDI)             │
 *                  │            │               │
 *                  │   Percept ↑│↓ Act          │
 *                  │            │               │
 *                  │      ┌──── Body ────┐      │
 *                  │      │              │      │
 *                  │      │  Apparatus   │      │
 *                  │      │      │       │      │
 *                  │      │   Element    │      │
 *                  │      └──────┬───────┘      │
 *                  └─────────────┼──────────────┘
 *                     Sensing ↑  │  ↓ Behaving
 *                                │
 *                         Physical World
 *
 * The Apparatus operates at the intersection of two fundamental
 * relationships:
 *
 *   Mind <-> Body
 *
 *     Percept
 *       Exposes information perceived through a bodily Element to the BDI
 *       mind when requested. A Percept returns a PerceptReturn containing
 *       its current status and, when available, the perceived value or values.
 *
 *     Act
 *       Allows the BDI mind to intentionally request a bodily operation
 *       through an Element. An Act returns an ActionResponse indicating the
 *       outcome of the requested operation.
 *
 *   Body <-> Physical World
 *
 *     Sensing
 *       Allows Elements to continuously acquire or update information about
 *       the body and the physical world.
 *
 *     Behaving
 *       Allows Elements to continuously perform and maintain bodily processes
 *       in the physical world.
 *
 * The runtime of an Apparatus is coordinated by embody(), which repeatedly
 * executes the following body cycle:
 *
 *     sensing();
 *     inhabitance();
 *     behaving();
 *
 * Sensing first allows the body to update its physical state. Inhabitance
 * then maintains the operational interaction between the body and the BDI
 * mind. Finally, Behaving allows bodily processes to continue acting in the
 * physical world.
 *
 * Besides coordinating this cycle, Apparatus is responsible for:
 *
 *   - registering Acts, Percepts, Sensing and Behaving processes associated
 *     with its Elements;
 *   - receiving requests from the BDI mind through JSON_SLP;
 *   - exposing bodily Percepts and their returned values to the BDI mind;
 *   - exposing Acts currently supported by the body;
 *   - dispatching Acts requested by the BDI mind and returning their
 *     ActionResponse;
 *   - exposing TacitKnowledge carried by the body;
 *   - conveying Trieb generated by bodily processes to the BDI mind;
 *   - identifying the instantiated Apparatus in exchanged messages; and
 *   - recording the most recent evidence of the BDI mind's presence in the
 *     body.
 *
 * This file is an internal component of NECK. It is included by NECK.hpp
 * inside namespace NECK and depends on the definitions provided by
 * NECKCore.hpp and NECKBody.hpp.
 *
 * ============================================================================
 */

class Apparatus {

public:

  /*
   * Creates an Apparatus identified by name.
   *
   * The newly created Apparatus becomes the current Apparatus instance used
   * by the NECK DSL when Elements are declared.
   *
   * An Apparatus identifier is derived from the build signature and its name
   * using FNV-1a. This identifier accompanies exchanged messages and allows
   * the physical Apparatus that produced them to be distinguished.
   */
  explicit Apparatus(const char* name)
    : _name(name),
      _begun(false),
      _actions(nullptr),
      _percepts(nullptr),
      _sensings(nullptr),
      _behavings(nullptr),
      _jslp(Serial) {

        instanceRef() = this;

        _apparatusID = fnv1a(BUILD_SIGNATURE, _apparatusID);
        _apparatusID = fnv1a(_name, _apparatusID);
  }


  /*
   * Returns the Apparatus currently associated with the NECK body
   * declarations.
   *
   * Element declarations use this reference to associate themselves with
   * their containing Apparatus.
   */
  static Apparatus* instance() {
    return instanceRef();
  }


  /*
   * Returns the symbolic name assigned to this Apparatus.
   */
  const char* name() const {
    return _name;
  }


  /*
   * Initializes the communication channel used by the Apparatus.
   */
  void begin(unsigned long baud) {
    Serial.begin(baud);
    _begun = true;
  }


  /*
   * ==========================================================================
   * Body-process registration
   * ==========================================================================
   *
   * The methods below maintain the runtime registries associated with the
   * Elements that constitute this Apparatus.
   *
   * Registration is normally performed automatically by the NECK DSL through
   * Act, Percept, Sensing and Behaving declarations. Application code
   * generally does not need to call these methods directly.
   * ==========================================================================
   */


  /*
   * Registers an Act that can be requested through the specified Element.
   */
  void addAction(
    const char* elementName,
    const char* actionName,
    ActionFn fn
  ) {
    ActionEntry* ae = new ActionEntry();

    ae->elementName = elementName;
    ae->actionName  = actionName;
    ae->fn          = fn;
    ae->next        = _actions;

    _actions = ae;
  }


  /*
   * Registers a Percept exposed by the specified Element.
   *
   * The perception type identifies how the percept relates to the body:
   * interoception, proprioception or exteroception.
   */
  void addPerception(
    const char* elementName,
    const char* perceptName,
    PerceptionType t,
    PerceptionFn fn
  ) {
    PerceptionEntry* pe = new PerceptionEntry();

    pe->elementName = elementName;
    pe->perceptName = perceptName;
    pe->type        = t;
    pe->fn          = fn;
    pe->next        = _percepts;

    _percepts = pe;
  }


  /*
   * Registers the continuous Sensing process associated with an Element.
   */
  void addSensing(const char* elementName, SensingFn fn) {
    SensingEntry* se = new SensingEntry();

    se->elementName = elementName;
    se->fn          = fn;
    se->next        = _sensings;

    _sensings = se;
  }


  /*
   * Executes one iteration of every registered Sensing process.
   *
   * Sensing belongs to the body-side interaction with the physical world.
   * It runs independently of whether the BDI mind explicitly requests a
   * Percept during the current embodiment cycle.
   */
  void sensing() {
    for (SensingEntry* s = _sensings; s != nullptr; s = s->next) {
      s->fn();
    }
  }


  /*
   * Registers the continuous Behaving process associated with an Element.
   */
  void addBehaving(const char* elementName, BehavingFn fn) {
    BehavingEntry* be = new BehavingEntry();

    be->elementName = elementName;
    be->fn          = fn;
    be->next        = _behavings;

    _behavings = be;
  }


  /*
   * Executes one iteration of every registered Behaving process.
   *
   * Behaving belongs to the body-side interaction with the physical world
   * and allows ongoing bodily behavior to persist independently of new
   * deliberative commands from the BDI mind.
   */
  void behaving() {
    for (BehavingEntry* b = _behavings; b != nullptr; b = b->next) {
      b->fn();
    }
  }


  /*
   * ==========================================================================
   * Embodiment cycle
   * ==========================================================================
   */


  /*
   * Executes one complete embodiment cycle.
   *
   * embody() is the main runtime operation of an Apparatus and should be
   * invoked repeatedly by the embedded application.
   *
   * Each cycle is intentionally organized into three stages:
   *
   *     sensing();
   *     inhabitance();
   *     behaving();
   *
   * Sensing
   *   Allows the body to continuously acquire and update information about
   *   itself and the physical world.
   *
   * Inhabitance
   *   Maintains the operational relationship between the body and the BDI
   *   mind inhabiting it. Through this relation, Percepts can flow toward
   *   the mind and Acts can flow toward the body.
   *
   * Behaving
   *   Allows bodily processes to continue and evolve in the physical world,
   *   including behavior previously initiated by the BDI mind.
   *
   * These stages are deliberately independent. In particular, the absence
   * of an incoming request during inhabitance() must not prevent behaving()
   * from executing in the same embodiment cycle.
   */
  void embody() {
    sensing();
    inhabitance();
    behaving();
  }


  /*
   * Maintains the operational relation between the body and the BDI mind
   * inhabiting it.
   *
   * inhabitance() processes an incoming NECK request, when available, and
   * mediates the corresponding interaction between mind and body.
   *
   * Supported requests include:
   *
   *   getPercepts
   *     Exposes the Percepts currently provided by the body's Elements.
   *
   *   getActions
   *     Exposes Acts currently available through the body's Elements.
   *
   *   getKnowHow
   *     Exposes TacitKnowledge carried by the current body.
   *
   *   Act request
   *     Requests execution of an Act by one or more Elements.
   *
   * When a valid request is processed, lastPresence is updated. Therefore,
   * lastPresence represents the most recent evidence that a mind has
   * interacted with, and consequently inhabited, this body.
   *
   * Returning from this method does not interrupt the embodiment cycle.
   * Control returns to embody(), allowing Behaving to execute normally.
   */
  void inhabitance() {

    if (!_begun)
      begin(115200);

    if (!_jslp.incoming())
      return;

    if (!_jslp.updateDoc(_JSONmsg))
      return;

    const char* msg = _JSONmsg["msg"];

    if (!msg || msg[0] == '\0')
      return;

    if (strstr(msg, "getPercepts") != nullptr) {
      streamPercepts();
    }

    else if (strstr(msg, "getKnowHow") != nullptr) {
      streamKnowHow();
    }

    else if (strstr(msg, "getActions") != nullptr) {

      String element = _JSONmsg["element"].as<String>();

      if (element.length() == 0 || element == "null")
        streamActions(nullptr);
      else
        streamActions(element.c_str());
    }

    else {
      streamAction(
        _JSONmsg["msg"].as<String>(),
        _JSONmsg["element"].as<String>(),
        JSONtoNECKArgs(_JSONmsg["args"])
      );
    }

    lastPresence = millis();
  }


  /*
   * ==========================================================================
   * Mind-body communication
   * ==========================================================================
   *
   * The following methods serialize the information exchanged between the
   * Apparatus and the BDI mind using JSON_SLP.
   * ==========================================================================
   */


  /*
   * Processes an Act requested by the BDI mind.
   *
   * When an Element is explicitly identified, the Act is dispatched only to
   * that Element (unicast).
   *
   * When no Element is identified, the Act is dispatched to every Element
   * that provides an Act with the requested name (broadcast).
   *
   * The complete set of responses is transmitted within one JSON_SLP
   * transmission.
   */
  void streamAction(String action, String element, NECKArgs args) {

    _jslp.startTransmission();

    if (!action.length() == 0) {

      if (element.length() > 0 && element != "null") {

        // Unicast: the Act is directed to one specific Element.
        ActionResponse r =
          dispatchActionUnicast(
            element.c_str(),
            action.c_str(),
            args
          );

        sendActionResultJSON(
          element.c_str(),
          action.c_str(),
          r
        );
      }

      else {

        // Broadcast: every Element providing the requested Act receives it.

        bool any =
          dispatchActionBroadcast(
            action.c_str(),
            args
          );

        /*
         * If no Element provides the requested Act, the Apparatus itself
         * reports the request as unknown.
         */
        if (!any) {
          _JSONmsg.clear();

          _JSONmsg["apparatus"]    = _name;
          _JSONmsg["bodyResponse"] =
            actionResponseToStr(ActionResponse::UNKNOWN);
          _JSONmsg["request"]      = action;
          _JSONmsg["apparatusID"]  = _apparatusID;

          _jslp.transmit(_JSONmsg);
        }
      }
    }

    _jslp.endTransmission();
  }


  /*
   * Exposes the body's currently registered Percepts to the BDI mind.
   *
   * The transmission begins with a response identifying the Apparatus and
   * request. Each registered Percept is subsequently evaluated and
   * transmitted together with:
   *
   *   - its name;
   *   - originating Element;
   *   - perception type;
   *   - perception status; and
   *   - optional returned arguments.
   *
   * Percepts are therefore evaluated when the mind requests them rather than
   * continuously during Sensing.
   */
  void streamPercepts() {

    _jslp.startTransmission();

    /*
     * Transmission header identifying the request and responding Apparatus.
     */
    _JSONmsg.clear();

    _JSONmsg["apparatus"]    = _name;
    _JSONmsg["bodyResponse"] =
      actionResponseToStr(ActionResponse::EXECUTED);
    _JSONmsg["request"]      = "getPercepts";
    _JSONmsg["apparatusID"]  = _apparatusID;

    _jslp.transmit(_JSONmsg);


    /*
     * Evaluate and transmit every Percept registered by the body's Elements.
     */
    for (
      PerceptionEntry* p = _percepts;
      p != nullptr;
      p = p->next
    ) {

      PerceptReturn ret = p->fn();

      _JSONmsg.clear();

      _JSONmsg["percept"] = p->perceptName;
      _JSONmsg["element"] = p->elementName;
      _JSONmsg["type"] =
        perceptionTypeToStr(p->type);
      _JSONmsg["status"] =
        perceptionResponseToStr(ret.status);


      /*
       * Preserve the NECK argument types when constructing the JSON response.
       */
      if (ret.hasArgs) {

        for (uint8_t i = 0; i < ret.args.size(); i++) {

          const ArgValue& av = ret.args.at(i);

          switch (av.type) {

            case ARG_BOOL:
              _JSONmsg["args"][i] = av.v.b;
              break;

            case ARG_INT:
              _JSONmsg["args"][i] = av.v.i;
              break;

            case ARG_UINT:
              _JSONmsg["args"][i] = av.v.u;
              break;

            case ARG_FLOAT:
              _JSONmsg["args"][i] = av.v.f;
              break;

            case ARG_STRING:
              _JSONmsg["args"][i] = av.s;
              break;
          }
        }
      }

      _jslp.transmit(_JSONmsg);
    }

    _jslp.endTransmission();
  }


  /*
   * Exposes the Acts currently available through this Apparatus.
   *
   * If onlyElement is null, Acts from all Elements are transmitted.
   *
   * If an Element name is provided, only Acts belonging to that Element are
   * exposed.
   */
  void streamActions(const char* onlyElement) {

    _jslp.startTransmission();

    /*
     * Transmission header identifying the request and responding Apparatus.
     */
    _JSONmsg.clear();

    _JSONmsg["apparatus"]    = _name;
    _JSONmsg["bodyResponse"] =
      actionResponseToStr(ActionResponse::EXECUTED);
    _JSONmsg["request"]      = "getActions";
    _JSONmsg["apparatusID"]  = _apparatusID;

    _jslp.transmit(_JSONmsg);


    /*
     * Transmit every matching Act registered by the body's Elements.
     */
    for (
      ActionEntry* a = _actions;
      a != nullptr;
      a = a->next
    ) {

      if (
        onlyElement &&
        strcmp(a->elementName, onlyElement) != 0
      )
        continue;

      _JSONmsg.clear();

      _JSONmsg["action"]  = a->actionName;
      _JSONmsg["element"] = a->elementName;

      _jslp.transmit(_JSONmsg);
    }

    _jslp.endTransmission();
  }


  /*
   * Exposes the TacitKnowledge carried by this body.
   *
   * TacitKnowledge describes know-how associated with bodily capabilities.
   * By exposing this knowledge, the current embodiment can inform the BDI
   * mind about skills that become available through its physical body.
   *
   * Entries are stored in program memory inside the "neck_tacit" linker
   * section. The linker-provided section boundaries are used here to discover
   * and iterate over every registered TacitKnowledge entry.
   */
  void streamKnowHow() {

    _jslp.startTransmission();

    /*
     * Transmission header identifying the request and responding Apparatus.
     */
    _JSONmsg.clear();

    _JSONmsg["apparatus"]    = _name;
    _JSONmsg["bodyResponse"] =
      actionResponseToStr(ActionResponse::EXECUTED);
    _JSONmsg["request"]      = "getKnowHow";
    _JSONmsg["apparatusID"]  = _apparatusID;

    _jslp.transmit(_JSONmsg);


    /*
     * Locate the linker section containing TacitKnowledge entries.
     */
    const uintptr_t start =
      (uintptr_t)::__start_neck_tacit;

    const uintptr_t stop =
      (uintptr_t)::__stop_neck_tacit;


    /*
     * An empty or invalid section means that the body carries no
     * TacitKnowledge to expose.
     */
    if (stop <= start) {
      _jslp.endTransmission();
      return;
    }


    const uint16_t total =
      (uint16_t)((stop - start) / sizeof(TacitEntry));

    const TacitEntry* base =
      (const TacitEntry*)start;


    /*
     * Read each entry from program memory and transmit its skill, optional
     * context and corresponding plan.
     */
    for (uint16_t i = 0; i < total; i++) {

      const TacitEntry* e = &base[i];

      /*
       * Read the pointers stored in the flash-resident structure.
       */
      const char* knP =
        (const char*)pgm_read_ptr(&e->skill);

      const char* ctxP =
        (const char*)pgm_read_ptr(&e->context);

      const char* plP =
        (const char*)pgm_read_ptr(&e->plan);


      /*
       * Ignore the sentinel and incomplete entries.
       */
      if (!knP || !plP)
        continue;


      _JSONmsg.clear();

      char tempBuffer[128];


      copyPROGMEM(
        knP,
        tempBuffer,
        sizeof(tempBuffer)
      );

      _JSONmsg["skill"] = tempBuffer;


      if (ctxP) {
        copyPROGMEM(
          ctxP,
          tempBuffer,
          sizeof(tempBuffer)
        );
      }

      _JSONmsg["context"] =
        ctxP ? tempBuffer : nullptr;


      copyPROGMEM(
        plP,
        tempBuffer,
        sizeof(tempBuffer)
      );

      _JSONmsg["plan"] = tempBuffer;


      _jslp.transmit(_JSONmsg);
    }

    _jslp.endTransmission();
  }


  /*
   * ==========================================================================
   * Act dispatch
   * ==========================================================================
   */


  /*
   * Dispatches an Act to one specific Element.
   *
   * The requested Act is identified by the combination of Element name and
   * Act name.
   *
   * UNKNOWN is returned when no corresponding Act is registered.
   *
   * UNABLE is returned if the entry exists but does not provide an executable
   * function.
   */
  ActionResponse dispatchActionUnicast(
    const char* elementName,
    const char* actionName,
    const NECKArgs& args
  ) {

    for (
      ActionEntry* a = _actions;
      a != nullptr;
      a = a->next
    ) {

      if (
        strcmp(a->elementName, elementName) == 0 &&
        strcmp(a->actionName, actionName) == 0
      ) {
        return a->fn
          ? a->fn(args)
          : UNABLE;
      }
    }

    return UNKNOWN;
  }


  /*
   * Dispatches an Act to every Element that provides an Act with the
   * requested name.
   *
   * Each matching Element executes its own Act function and produces an
   * independent body response.
   *
   * Returns true when at least one compatible Act was found.
   */
  bool dispatchActionBroadcast(
    const char* actionName,
    const NECKArgs& args
  ) {

    bool any = false;

    for (
      ActionEntry* a = _actions;
      a != nullptr;
      a = a->next
    ) {

      if (strcmp(a->actionName, actionName) == 0) {

        any = true;

        ActionResponse r =
          a->fn
            ? a->fn(args)
            : UNABLE;

        sendActionResultJSON(
          a->elementName,
          actionName,
          r
        );
      }
    }

    return any;
  }


  /*
   * ==========================================================================
   * Body-to-mind signaling and responses
   * ==========================================================================
   */


  /*
   * Transmits a Trieb originating from an Element toward the BDI mind.
   *
   * A Trieb represents a body-originated drive. The transmitted message
   * identifies:
   *
   *   - the originating Apparatus;
   *   - the originating Element;
   *   - the Trieb name;
   *   - its Drang intensity; and
   *   - optional associated arguments.
   *
   * This method assumes that a JSON_SLP transmission is already open.
   */
  void sendTriebJSON(
    const char* elementName,
    const char* triebName,
    const NECKArgs* argsOrNull,
    double drang
  ) {

    _JSONmsg.clear();

    _JSONmsg["apparatus"]   = _name;
    _JSONmsg["trieb"]       = triebName;
    _JSONmsg["drang"]       = drang;
    _JSONmsg["apparatusID"] = _apparatusID;
    _JSONmsg["element"]     = elementName;


    /*
     * Preserve the NECK argument types in the JSON representation.
     */
    if (argsOrNull && argsOrNull->size() > 0) {

      for (
        uint8_t i = 0;
        i < argsOrNull->size();
        i++
      ) {

        const ArgValue& av =
          argsOrNull->at(i);

        switch (av.type) {

          case ARG_BOOL:
            _JSONmsg["args"][i] = av.v.b;
            break;

          case ARG_INT:
            _JSONmsg["args"][i] = av.v.i;
            break;

          case ARG_UINT:
            _JSONmsg["args"][i] = av.v.u;
            break;

          case ARG_FLOAT:
            _JSONmsg["args"][i] = av.v.f;
            break;

          case ARG_STRING:
            _JSONmsg["args"][i] = av.s;
            break;
        }
      }
    }

    _jslp.transmit(_JSONmsg);
  }


  /*
   * Transmits the result of an Act requested by the BDI mind.
   *
   * The response identifies both the Apparatus and the Element responsible
   * for processing the requested Act.
   */
  void sendActionResultJSON(
    const char* elementName,
    const char* actionName,
    ActionResponse r
  ) {

    _JSONmsg.clear();

    _JSONmsg["apparatus"]    = _name;
    _JSONmsg["bodyResponse"] =
      actionResponseToStr(r);
    _JSONmsg["request"]      = actionName;
    _JSONmsg["apparatusID"]  = _apparatusID;
    _JSONmsg["element"]      = elementName;

    _jslp.transmit(_JSONmsg);
  }


  /*
   * Returns the timestamp, in milliseconds, of the most recent interaction
   * that provided evidence of a mind inhabiting this body.
   */
  unsigned long getLastPresence() {
    return lastPresence;
  }


private:

  /*
   * ==========================================================================
   * Runtime state
   * ==========================================================================
   */


  // JSON_SLP endpoint used for mind-body communication.
  JSON_SLP _jslp;

  // Reusable JSON document used while receiving and transmitting messages.
  JsonDocument _JSONmsg;

  // Symbolic name of this Apparatus.
  const char* _name;

  // Indicates whether the communication channel has been initialized.
  bool _begun;


  /*
   * Runtime registries containing the processes provided by the Elements
   * that constitute this Apparatus.
   */
  ActionEntry*     _actions;
  PerceptionEntry* _percepts;
  SensingEntry*    _sensings;
  BehavingEntry*   _behavings;


  /*
   * Timestamp of the most recent evidence of the mind's presence.
   *
   * This value is updated after a valid incoming request has been processed
   * during inhabitance().
   */
  unsigned long lastPresence = 0;


  /*
   * Identifier associated with this Apparatus instance.
   *
   * The initial value is the FNV-1a offset basis and is subsequently extended
   * with BUILD_SIGNATURE and the Apparatus name by the constructor.
   */
  uint32_t _apparatusID = 2166136261UL;


  /*
   * ==========================================================================
   * Internal helpers
   * ==========================================================================
   */


  /*
   * Extends an FNV-1a hash with the characters contained in s.
   */
  static uint32_t fnv1a(
    const char* s,
    uint32_t hash
  ) {

    while (*s) {
      hash ^= (uint8_t)*s++;
      hash *= 16777619UL;
    }

    return hash;
  }


  /*
   * Stores the Apparatus instance referenced by Element declarations in the
   * NECK DSL.
   */
  static Apparatus*& instanceRef() {

    static Apparatus* ptr = nullptr;

    return ptr;
  }


  /*
   * Converts an internal Act response into the textual representation used
   * by the NECK communication protocol.
   */
  static const __FlashStringHelper*
  actionResponseToStr(ActionResponse r) {

    switch (r) {

      case EXECUTED:
        return F("executed");

      case UNABLE:
        return F("unable");

      case ALREADY:
        return F("already");

      case REJECTED:
        return F("rejected");

      case INVALID:
        return F("invalid");

      case UNKNOWN:
        return F("unknown");

      default:
        return F("unknown");
    }
  }


  /*
   * Converts an internal Percept response into the textual representation
   * used by the NECK communication protocol.
   */
  static const __FlashStringHelper*
  perceptionResponseToStr(PerceptionResponse r) {

    switch (r) {

      case PERCEPTED:
        return F("percepted");

      case UNAVAILABLE:
        return F("unavailable");

      case UNCHANGED:
        return F("unchanged");

      default:
        return F("percepted");
    }
  }


  /*
   * Converts a PerceptionType into the textual representation used by the
   * NECK communication protocol.
   */
  static const __FlashStringHelper*
  perceptionTypeToStr(PerceptionType t) {

    switch (t) {

      case INTEROCEPTION:
        return F("interoception");

      case PROPRIOCEPTION:
        return F("proprioception");

      case EXTEROCEPTION:
        return F("exteroception");

      default:
        return F("proprioception");
    }
  }


  /*
   * Copies a null-terminated string stored in program memory into a
   * caller-provided RAM buffer.
   */
  static void copyPROGMEM(
    const char* p,
    char* out,
    size_t outSize
  ) {

    if (!p || outSize == 0)
      return;

    size_t n =
      strnlen_P(
        p,
        outSize - 1
      );

    memcpy_P(
      out,
      p,
      n
    );

    out[n] = '\0';
  }


  /*
   * Converts a JSON argument array into NECK's typed argument
   * representation.
   *
   * JSON values are inspected individually and mapped to the corresponding
   * NECK ArgType whenever possible:
   *
   *   bool        -> ARG_BOOL
   *   signed int  -> ARG_INT
   *   uint32_t    -> ARG_UINT
   *   float       -> ARG_FLOAT
   *   string      -> ARG_STRING
   *
   * Unsupported JSON values are serialized to String so their representation
   * is not silently discarded.
   */
  static NECKArgs JSONtoNECKArgs(JsonVariantConst jargs) {

    NECKArgs out;

    if (jargs.isNull())
      return out;

    if (!jargs.is<JsonArrayConst>())
      return out;


    for (
      JsonVariantConst v :
      jargs.as<JsonArrayConst>()
    ) {

      if (v.is<bool>()) {
        out.add(v.as<bool>());
      }

      else if (v.is<int>()) {
        out.add(
          (int32_t)v.as<int>()
        );
      }

      else if (v.is<long>()) {
        out.add(
          (int32_t)v.as<long>()
        );
      }

      else if (v.is<uint32_t>()) {
        out.add(
          v.as<uint32_t>()
        );
      }

      else if (v.is<float>()) {
        out.add(
          (float)v.as<float>()
        );
      }

      else if (v.is<double>()) {
        out.add(
          (float)v.as<double>()
        );
      }

      else if (v.is<const char*>()) {
        out.add(
          v.as<const char*>()
        );
      }

      else {
        String tmp;

        serializeJson(v, tmp);

        out.add(tmp);
      }
    }

    return out;
  }
};


/*
 * ============================================================================
 * Element-Apparatus binding
 * ============================================================================
 *
 * ElementDef is declared before Apparatus because the structural definition
 * of the body needs to reference the Apparatus that owns each Element.
 *
 * Operations below, however, require the complete Apparatus definition.
 * Their implementations are therefore placed here, after the Apparatus class
 * has been fully defined.
 * ============================================================================
 */


/*
 * Associates an Element with its name and containing Apparatus.
 */
inline ElementDef::ElementDef(
  const char* n,
  Apparatus* a
)
  : name(n),
    apparatus(a) {}


/*
 * Sends a body-originated Trieb from this Element through its containing
 * Apparatus.
 */
inline void ElementDef::trieb(
  const char* triebName,
  double drang
) {

  if (!apparatus || !triebName)
    return;

  apparatus->sendTriebJSON(
    name,
    triebName,
    nullptr,
    drang
  );
}


/*
 * Sends a body-originated Trieb with arguments from this Element through its
 * containing Apparatus.
 */
inline void ElementDef::trieb(
  const char* triebName,
  const NECKArgs& args,
  double drang
) {

  if (!apparatus || !triebName)
    return;

  apparatus->sendTriebJSON(
    name,
    triebName,
    &args,
    drang
  );
}